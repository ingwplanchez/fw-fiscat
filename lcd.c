#include "includes.h"
#include "dotlcd.h"
#include "dotlcd_c.h"
#include "lcd.h"

 uint8_t DotLcdMap[DOTLCD_DOT_ROW][(DOTLCD_DOT_COL+7)/8];
 uint8_t custDotLcdMap[CUSTOMER_LCD_DOT_ROW][(CUSTOMER_LCD_DOT_COL+7)/8];
DOTLCDDISPLAY *main_lcddisplay;
 CUSTLCDDISPLAY *cust_lcddisplay;

//#define LOGO_FISCAL     0
//#define LOGO_ITALY      1
//#define LOGOFLAG        LOGO_ITALY
//#if LOGOFLAG == LOGO_ITALY
//// 意大利logo
const uint8_t fiscatlogo[] = {
0x00,0x00,0x00,0x0F,0xFF,0xF0,0x00,0x00,0x00,0x00,0x00,0x00,0x00,0x00,0x00,0x00,
0x00,0x00,0x01,0xFF,0xFF,0xFE,0x00,0x00,0x00,0x00,0x00,0x00,0x00,0x00,0x00,0x00,
0x00,0x00,0x3F,0xFF,0xFF,0xFF,0xC0,0x00,0x00,0x00,0x00,0x00,0x00,0x00,0x00,0x00,
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0x00,0x00,0x00,0x0F,0xFF,0xE0,0x00,0x00,0x00,0x00,0x00,0x00,0x00,0x00,0x00,0x00,
};
//#else
// fiscat logo
//const uint8_t fiscatlogo[] = {
//0x00,0x00,0x00,0x00,0x00,0x00,0x00,0x00,0x00,0x00,0x00,0x00,0x00,0x00,0x00,0x00,
//0x00,0x00,0x00,0x00,0x00,0x00,0x00,0x00,0x00,0x0C,0x00,0x00,0x00,0x00,0x00,0x00,
//0x00,0x00,0x00,0x00,0x00,0x00,0x00,0x00,0x00,0x1C,0x00,0x00,0x00,0x00,0x00,0x00,
//0x00,0x00,0x00,0x00,0x00,0x00,0x00,0x00,0x00,0x1E,0x00,0x00,0x00,0x00,0x00,0x00,
//0x00,0x00,0x00,0x00,0x00,0x00,0x00,0x00,0x00,0x3E,0x00,0x00,0x00,0x00,0x00,0x00,
//0x00,0x00,0x00,0x00,0x00,0x00,0x00,0x00,0x01,0xFF,0x00,0x00,0x00,0x00,0x00,0x00,
//0x00,0x00,0x00,0x1F,0xE0,0x00,0x00,0x00,0x0F,0xFF,0xC0,0x00,0x00,0x00,0x00,0x00,
//0x3F,0xFF,0xFC,0x1F,0xE0,0x00,0x00,0x07,0xDF,0xFF,0xE0,0x00,0x00,0x00,0x00,0x00,
//0x3F,0xFF,0xFC,0x1F,0xC0,0x00,0x00,0x07,0xFF,0xFF,0xF0,0x00,0x00,0x00,0x00,0x00,
//0x3F,0xFF,0xF8,0x1F,0xE0,0x00,0x00,0x07,0xFF,0xFF,0xF0,0x00,0x00,0x00,0x00,0x00,
//0x3F,0xFF,0xFC,0x1F,0xC0,0x00,0x00,0x03,0xFF,0xFF,0xF0,0x00,0x00,0x00,0x00,0x00,
//0x3F,0xFF,0xF8,0x00,0x00,0x00,0x00,0x03,0xFF,0x03,0xF0,0x1F,0xC7,0x82,0x02,0x40,
//0x3F,0x80,0x00,0x00,0x00,0x00,0x00,0x03,0xFC,0x00,0xC0,0x7F,0xFF,0x83,0x86,0xC0,
//0x3F,0x80,0x00,0x1F,0xE0,0x0F,0xFE,0x03,0xFC,0x00,0x01,0xFF,0xFF,0x01,0xC5,0xC0,
//0x3F,0x80,0x00,0x1F,0xE0,0x3F,0xFE,0x07,0xF8,0x00,0x07,0xFF,0xFE,0x01,0xE8,0x30,
//0x3F,0x80,0x00,0x1F,0xC0,0x3F,0xFE,0x07,0xF0,0x00,0x07,0xF8,0x3E,0x01,0xFE,0x60,
//0x3F,0x80,0x00,0x1F,0xC0,0x7F,0xFE,0x07,0xF0,0x00,0x0F,0xC0,0x3E,0x01,0xFE,0x00,
//0x3F,0xFF,0xE0,0x1F,0xC0,0x7F,0xFE,0x07,0xF0,0x00,0x0F,0xC0,0x3C,0x01,0xEE,0xC0,
//0x7F,0xFF,0xE0,0x1F,0xC0,0x7F,0x80,0x07,0xE0,0x00,0x1F,0x80,0x3C,0x03,0xEE,0xC0,
//0x3F,0xFF,0xE0,0x1F,0xE0,0x7F,0x80,0x07,0xE0,0x00,0x1F,0x00,0x7C,0x03,0xE4,0x00,
//0x7F,0xFF,0xE0,0x1F,0xC0,0x7F,0x80,0x07,0xE0,0x00,0x3F,0x00,0x7C,0x03,0xE0,0x00,
//0x7F,0xFF,0xE0,0x3F,0xC0,0x3F,0xE0,0x00,0x00,0x00,0x3F,0x00,0x78,0x03,0xE0,0x00,
//0x7F,0x80,0x00,0x1F,0xC0,0x1F,0xF0,0x01,0x70,0x00,0x7F,0x00,0x78,0x07,0xE0,0x00,
//0x7F,0x80,0x00,0x3F,0xC0,0x0F,0xF8,0x07,0xF0,0x00,0x7F,0x00,0x78,0x07,0xC0,0x00,
//0x7F,0x80,0x00,0x1F,0xC0,0x07,0xFC,0x07,0xC0,0x00,0x7F,0x00,0x78,0x07,0xC0,0x00,
//0x7F,0x80,0x00,0x3F,0xC0,0x01,0xFE,0x03,0x9C,0x00,0x3F,0x00,0x7C,0x07,0xC0,0x00,
//0x7F,0x80,0x00,0x3F,0xC0,0x01,0xFE,0x00,0x7B,0x00,0x3F,0x80,0x7C,0x0F,0xC0,0x00,
//0x7F,0x80,0x00,0x3F,0xC1,0xC1,0xFE,0x01,0xF3,0xE0,0x3F,0xF1,0xFC,0x0F,0xC0,0x80,
//0x7F,0x80,0x00,0x3F,0xC1,0xFF,0xFE,0x00,0xF7,0xF8,0x1F,0xFF,0xFF,0x0F,0xC3,0x00,
//0x7F,0x80,0x00,0x3F,0xC0,0xFF,0xFE,0x00,0x67,0xF8,0x1F,0xFF,0xFF,0xF7,0xFF,0x00,
//0x7F,0x80,0x00,0x3F,0xC0,0xFF,0xFC,0x00,0x0F,0xF8,0x0F,0xFF,0xDF,0xE7,0xFE,0x00,
//0x7F,0x80,0x00,0x3F,0xC0,0xFF,0xF8,0x00,0x07,0xF8,0x07,0xFF,0x87,0x83,0xF8,0x00,

//};
//#endif

extern void initLcd(void)
{
    initDotLcd();
    initCustDotLcd();

    main_lcddisplay = getMainLcdDisplay();
    cust_lcddisplay = getCustLcdDisplay();
}
static void lcd_direct_update(uint8_t lcdtype)
{
    if(lcdtype&MAINLCD) dotlcd_set_direct_update();
    if(lcdtype&CUSTLCD) custlcd_set_direct_update();
}
extern void lcd_displayString(uint8_t lcdtype,uint8_t texttype,uint8_t row,uint8_t col,uint8_t *str)
{
    uint8_t *ptr;
    uint16_t r,c,startcol;
    startcol = col;
    ptr = str;
    if(lcdtype&MAINLCD)
    {
        for(r = row; r < MLCDLINE ;r++)
        {
            for(c = startcol; c < MLCDBUFLEN ; c++)
            {
                main_lcddisplay[r].buffer[c] = *ptr++;
                if(*ptr == 0) goto RETURN_1;
            }
            startcol = 0;
            if(texttype == 0x01) break; // 只显示一行,多余截掉
        }
    }
RETURN_1:
    startcol = col;
    ptr = str;
    if(lcdtype&CUSTLCD)
    {
        for(r = row; r < CUSTLCDLINE ;r++)
        {
            for(c = startcol; c < CUSTLCDBUFLEN ; c++)
            {
                cust_lcddisplay[r].buffer[c] = *ptr++;
                if(*ptr == 0) goto RETURN_2;
            }
            startcol = 0;
            if(texttype == 0x01) break; // 只显示一行,多余截掉
        }
    }
RETURN_2:
    return;
}

extern void lcd_displayMiddleStr(uint8_t lcdtype,uint8_t line,uint8_t *str)
{
    uint16_t len;
    len = strlen((const char *)str);
    if(lcdtype&MAINLCD)
    {
        memset(main_lcddisplay[line].buffer,' ',MLCDBUFLEN);
        if( len < MLCDBUFLEN)
        {
            sprintf((char *)main_lcddisplay[line].buffer,"%*s",(MLCDBUFLEN + len)/2,str);
        }
        else
        {
            sprintf((char *)&main_lcddisplay[line].buffer,"%.*s",MLCDBUFLEN,str);
        }
    }
    if(lcdtype&CUSTLCD)
    {
        memset(cust_lcddisplay[line].buffer,' ',CUSTLCDBUFLEN);
        if(len < CUSTLCDBUFLEN)
        {
            sprintf((char *)cust_lcddisplay[line].buffer,"%*s",(CUSTLCDBUFLEN + len)/2,str);
        }
        else
        {
            sprintf((char *)&cust_lcddisplay[line].buffer,"%.*s",CUSTLCDBUFLEN,str);
        }
    }
}
static int lcd_subpaint(uint8_t lcdtype,uint8_t maxrow,uint8_t maxcol,uint8_t startrow,uint8_t startcol,uint8_t width,uint8_t height,uint8_t *dt)
{
    uint8_t row,col;
    uint8_t i = 0;
    uint8_t dotbit;
    uint8_t n;
    if(startrow >= maxrow || startcol >= maxcol) return -1;
    for(row = startrow; row < (startrow + height) && row < maxrow; row++)
    {
        for(col = startcol; col < (startcol + width); col++)
        {
            n = col>>3;
            dotbit = 1<<(col&0x07);
            if(n < (maxcol+7)/8)
            {
                if(lcdtype&MAINLCD)
                {
                    DotLcdMap[row][n] &= ~dotbit;
                    if((*dt)&(1<<i))DotLcdMap[row][n] |= dotbit;
                }
                else if(lcdtype&CUSTLCD)
                {
                    custDotLcdMap[row][n] &= ~dotbit;
                    if((*dt)&(1<<i))custDotLcdMap[row][n] |= dotbit;
                }
            }
            if(++i >= 8)
            {
                i = 0;
                dt++;
            }
        }
    }
    return 0;
}
static int lcdRecHightlight(uint8_t lcdtype,uint8_t maxrow,uint8_t maxcol,uint8_t startrow,uint8_t startcol,uint8_t width,uint8_t height)
{
    uint8_t row,col;
    uint8_t dotbit;
    uint8_t n;
    if(startrow >= maxrow || startcol >= maxcol) return -1;
    for(row = startrow; row < (startrow + height) && row < maxrow; row++)
    {
        for(col = startcol; col < (startcol + width); col++)
        {
            n = col>>3;
            dotbit = 1<<(col&0x07);
            if(n < (maxcol+7)/8)
            {
                if(lcdtype&MAINLCD)
                {
                    DotLcdMap[row][n] ^= dotbit;
                }
                else if(lcdtype&CUSTLCD)
                {
                    custDotLcdMap[row][n] ^= dotbit;
                }
            }
        }
    }
    return 0;
}
int lcd_paint(uint8_t lcdtype,uint8_t startrow,uint8_t startcol,uint8_t width,uint8_t height,uint8_t *dotdat)
{
    if((lcdtype&MAINLCD) && (startrow < DOTLCD_DOT_ROW || startcol < DOTLCD_DOT_COL))
    {
        lcd_subpaint(MAINLCD,DOTLCD_DOT_ROW,DOTLCD_DOT_COL,startrow,startcol,width,height,dotdat);
    }
    if((lcdtype&CUSTLCD) && (startrow < CUSTOMER_LCD_DOT_ROW || startcol < CUSTOMER_LCD_DOT_COL))
    {
        lcd_subpaint(CUSTLCD,CUSTOMER_LCD_DOT_ROW,CUSTOMER_LCD_DOT_COL,startrow,startcol,width,height,dotdat);
    }
    lcd_direct_update(lcdtype);
    return 0;
}
int lcd_recHightlight(uint8_t lcdtype,uint8_t startrow,uint8_t startcol,uint8_t width,uint8_t height)
{
    if((lcdtype&MAINLCD) && (startrow < DOTLCD_DOT_ROW && startcol < DOTLCD_DOT_COL))
    {
        lcdRecHightlight(MAINLCD,DOTLCD_DOT_ROW,DOTLCD_DOT_COL,startrow,startcol,width,height);
    }
    if((lcdtype&CUSTLCD) && (startrow < CUSTOMER_LCD_DOT_ROW && startcol < CUSTOMER_LCD_DOT_COL))
    {
        lcdRecHightlight(CUSTLCD,CUSTOMER_LCD_DOT_ROW,CUSTOMER_LCD_DOT_COL,startrow,startcol,width,height);
    }
    lcd_direct_update(lcdtype);
    return 0;
}
//函  数:测试LCD
//参  数:无
//返  回:下一操作
static uint8_t const bitMap[8]={0x7f,0x3f,0x1f,0x0f,0x07,0x03,0x01,0x00};
//extern uint8_t testLcd(uint8_t lcdtype)
//{
//    uint8_t dotLcdMap[DOTLCD_DOT_ROW][(DOTLCD_DOT_COL+7)/8];
//    int idx,i;
//    BOOL nowcol;
//    Ulong keyrtn;
//    clearDotLcd();
//    memset(dotLcdMap,0xff,sizeof(dotLcdMap));
//    idx = 0;
//    nowcol = TRUE;
//    if(lcdtype&MAINLCD)
//    {
//        set_lcd_type(MAINLCD);
//        while(1)
//        {
//            keyrtn = checkKeyInput();
//            if(((keyrtn>>16)&0xffff) == evKEYDOWN && (keyrtn&0x00ff) == 8)
//            {
//                initDotLcd();
//                return 0;
//            }
//            SystemDelay(50);

//            if (nowcol)
//            {
//                memset(&dotLcdMap[idx][0],0,(DOTLCD_DOT_COL+7)/8);
//                showDotMap(&dotLcdMap[0][0]);
//                if (++idx >= DOTLCD_DOT_ROW)
//                {
//                    nowcol = FALSE;
//                    memset(dotLcdMap,0xff,sizeof(dotLcdMap));
//                    idx = 0;
//                }
//            }
//            else
//            {
//                for(i=0 ; i<DOTLCD_DOT_ROW ; i++)
//                {
//                    dotLcdMap[i][idx/8] &= bitMap[idx%8];
//                }
//                showDotMap(&dotLcdMap[0][0]);
//                if (++idx >= DOTLCD_DOT_COL)
//                {
//                    break;
//                }
//            }
//        }
//        initDotLcd();
//    }
//    if(lcdtype&CUSTLCD)
//    {
//        set_lcd_type(CUSTLCD);
//        clearCustDotLcd();
//        memset(dotLcdMap,0xff,sizeof(dotLcdMap));
//        idx = 0;
//        nowcol = TRUE;
//        while(1)
//        {
//            keyrtn = checkKeyInput();
//            if(((keyrtn>>16)&0xffff) == evKEYDOWN && (keyrtn&0x00ff) == 8)
//            {
//                initCustDotLcd();
//                return 0;
//            }
//            SystemDelay(50);

//            if (nowcol)
//            {
//                memset(&dotLcdMap[idx][0],0,(CUSTOMER_LCD_DOT_COL+7)/8);
//                showCustDotMap(&dotLcdMap[0][0]);
//                if (++idx >= CUSTOMER_LCD_DOT_ROW)
//                {
//                    nowcol = FALSE;
//                    memset(dotLcdMap,0xff,sizeof(dotLcdMap));
//                    idx = 0;
//                }
//            }
//            else
//            {
//                for(i=0 ; i<CUSTOMER_LCD_DOT_ROW ; i++)
//                {
//                    dotLcdMap[i][idx/8] &= bitMap[idx%8];
//                }
//                showCustDotMap(&dotLcdMap[0][0]);
//                if (++idx >= CUSTOMER_LCD_DOT_COL)
//                {
//                    break;
//                }
//            }
//        }
//        initCustDotLcd();
//    }
//    return 0;
//}
extern void display_logo(void)
{
    uint16_t row,col;
    uint16_t n;
    for(row = 0;row < 32; row++)
    {
        for(col = 0;col < 16;col++)
        {
            n = row*16 + col;
            DotLcdMap[row][col] = (fiscatlogo[n]);
            custDotLcdMap[row][col] = (fiscatlogo[n]);
        }
    }
    lcd_direct_update(MAINLCD|CUSTLCD);
    dotlcd_set_logoupdate();
    custlcd_set_logoupdate();
}

